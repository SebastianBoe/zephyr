## samples/benchmarks/coremark/boards/nrf54h20dk_nrf54h20_cpuapp_soc1_low_power.conf
```kconfig
CONFIG_NRF_REGTOOL_TOML_CONFIG_FILES="uicr/nrf54h20dk_nrf54h20_cpuapp.toml"
CONFIG_RTT_CONSOLE=n
CONFIG_USE_SEGGER_RTT=n
CONFIG_COREMARK_ITERATIONS=10000

CONFIG_LOG_BACKEND_UART=n
CONFIG_UART_CONSOLE=n
CONFIG_CONSOLE=n

CONFIG_APP_BUILD_MULTICORE=n
CONFIG_LOG=n
CONFIG_LOG_FRONTEND=n
CONFIG_LOG_FRONTEND_ONLY=n
CONFIG_LOG_PRINTK=n
CONFIG_CBPRINTF_FP_SUPPORT=n
CONFIG_CONSOLE=n
CONFIG_PRINTK_SYNC=n

CONFIG_LOG_FRONTEND_CORESIGHT_STM=n
CONFIG_LOG_FRONTEND_CORESIGHT_STM_FSC=n
```

## samples/benchmarks/coremark/remote/boards/nrf54h20dk_nrf54h20_cpuppr@soc1.conf
```kconfig
CONFIG_SERIAL=y
CONFIG_COREMARK_ITERATIONS=150
CONFIG_RTT_CONSOLE=n
CONFIG_USE_SEGGER_RTT=n
```

## samples/benchmarks/coremark/sample.yaml
```yaml
sample:
    name: CoreMark Benchmark
    description: CoreMark sample for the CPU performance evaluation.
                 Sample runs the CoreMark benchmark that measures the CPU efficiency
                 performing  different algorithms like state machine, crc calculation,
                 matrix manipulation and list processing (find and sort).
tests:
  sample.benchmark.coremark:
    build_only: true
    platform_allow: nrf52dk_nrf52832 nrf52840dk_nrf52840
    integration_platforms:
      - nrf52840dk_nrf52840
    tags: ci_build
  sample.benchmark.coremark.lowpower:
    build_only: true
    platform_allow: nrf54h20dk_nrf54h20_cpuapp_soc1
    integration_platforms:
      - nrf54h20dk_nrf54h20_cpuapp_soc1
    tags: ci_build
    extra_args:
      OVERLAY_CONFIG=boards/nrf54h20dk_nrf54h20_cpuapp_soc1_low_power.conf
```

## samples/bluetooth/peripheral_hr/boards/nrf54h20dk_nrf54h20_cpuapp_soc1.conf
```kconfig
CONFIG_SERIAL=y
CONFIG_CONSOLE=y
CONFIG_UART_CONSOLE=y

CONFIG_MBOX=y
CONFIG_IPC_SERVICE=y
CONFIG_IPC_SERVICE_BACKEND_RPMSG=y
CONFIG_IPC_SERVICE_BACKEND_RPMSG_SHMEM_RESET=y
CONFIG_MBOX_NRFX_IDS=y

CONFIG_HEAP_MEM_POOL_SIZE=4096

CONFIG_BT_RPMSG=y
```

## samples/boards/nrf/ieee802154/802154_rpmsg/boards/nrf54fpga_nrf5420soc1_cpunet.conf
```kconfig
CONFIG_RPMSG_SERVICE_NUM_ENDPOINTS=2

CONFIG_NRF_802154_ENCRYPTION=n
CONFIG_NRF_802154_TEMPERATURE_UPDATE=n
CONFIG_NRF_802154_SOURCE_INTERNAL=y

CONFIG_HEAP_MEM_POOL_SIZE=8192

CONFIG_NRF_IRQ_OFFLOAD=y
CONFIG_EGU_NRFX_DRIVER=y
CONFIG_NRFX_EGU020=y

CONFIG_MBOX=y
CONFIG_IPC_SERVICE=y
CONFIG_IPC_SERVICE_BACKEND_RPMSG=y
CONFIG_MBOX_NRFX_IDS=y
```

## samples/boards/nrf/ieee802154/802154_rpmsg/boards/nrf54fpga_nrf5440_cpunet.conf
```kconfig
CONFIG_RPMSG_SERVICE_NUM_ENDPOINTS=2

CONFIG_NRF_802154_ENCRYPTION=n
CONFIG_NRF_802154_TEMPERATURE_UPDATE=n
CONFIG_NRF_802154_SOURCE_INTERNAL=y

CONFIG_IPM_NRFX_BELLBOARD=y
CONFIG_IPM_NRFX_BELLBOARD0=y
CONFIG_IPM_NRFX_BELLBOARD0_TARGET=0

CONFIG_HEAP_MEM_POOL_SIZE=4096

CONFIG_NRF_IRQ_OFFLOAD=y
CONFIG_EGU_NRFX_DRIVER=y
CONFIG_NRFX_EGU020=y
```

## samples/sensor/qdec/sample.yaml
```yaml
sample:
  description: Usage quadrature decoder sensor
  name: qdec_sensor
common:
  timeout: 5
  harness: console
  harness_config:
    type: multi_line
    ordered: true
    regex:
      - "Quadrature decoder sensor test"
      - "Position = (.*) degrees"
tests:
  sample.sensor.qdec_sensor:
    tags: sensors
    platform_allow: nucleo_f401re
    harness_config:
      fixture: fixture_mech_encoder
  sample.sensor.nrf_qdec_sensor:
    platform_allow: nrf54h20dk_nrf54h20_cpuapp@soc1
    integration_platforms:
      - nrf54h20dk_nrf54h20_cpuapp@soc1
    harness_config:
      fixture: gpio_loopback
```

## samples/subsys/usb/cdc_acm/boards/nrf54h20dk_nrf54h20_cpuapp_soc1.conf
```kconfig
#
# Copyright (c) 2023 Nordic Semiconductor
#
# SPDX-License-Identifier: LicenseRef-BSD-5-Clause-Nordic
#

# Debug optimization
CONFIG_ASSERT=y
CONFIG_DEBUG=y
CONFIG_DEBUG_OPTIMIZATIONS=y

CONFIG_CONSOLE=y
CONFIG_UART_CONSOLE=y
CONFIG_STDOUT_CONSOLE=y

# Memory usage config
CONFIG_HEAP_MEM_POOL_SIZE=2048
CONFIG_ISR_STACK_SIZE=1024
CONFIG_MAIN_STACK_SIZE=2048
CONFIG_IDLE_STACK_SIZE=512
CONFIG_SYSTEM_WORKQUEUE_STACK_SIZE=2048

# NRFS configuration
CONFIG_NRFS_LOCAL_DOMAIN=y
CONFIG_NRFS_BACKEND_IPC_SERVICE=y
CONFIG_NRFS_BACKEND_RX_TASK_STACK_SIZE=2048
CONFIG_NRFS_BACKEND_TX_TASK_STACK_SIZE=2048

# Misc
CONFIG_NRF_REGTOOL_VERBOSE_ON=y

# Stack options
CONFIG_THREAD_STACK_INFO=y
CONFIG_STACK_SENTINEL=y

# Do not build additional images
CONFIG_INCLUDE_SECDOM=n
CONFIG_INCLUDE_SYSCTRL=n

CONFIG_MBOX_NRFX_IDS=y
#CONFIG_NRF_REGTOOL_GENERATE_TOML_CONFIG=y
#
CONFIG_LOG_MODE_IMMEDIATE=y
CONFIG_USB_DRIVER_LOG_LEVEL_INF=y

CONFIG_USB_DEVICE_PRODUCT="nRF54H20 CDC ACM"
CONFIG_USB_DW_USB_2_0=y
CONFIG_USB_DC_HAS_HS_SUPPORT=y

CONFIG_HWINFO=n
```
