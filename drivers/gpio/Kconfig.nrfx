## drivers/gpio/Kconfig.nrfx
```kconfig
# Copyright (c) 2018 Nordic Semiconductor ASA
# SPDX-License-Identifier: Apache-2.0

config GPIO_NRFX
	bool "nRF GPIO driver"
	default y
	depends on (DT_HAS_NORDIC_NRF_GPIO_ENABLED || DT_HAS_NORDIC_NRF_GPIO_V2_ENABLED)
	select NRFX_GPIOTE
	select NRFX_GPIOTE20 if HAS_HW_NRF_GPIOTE20
	select NRFX_GPIOTE30 if HAS_HW_NRF_GPIOTE30
	select NRFX_GPIOTE130 if HAS_HW_NRF_GPIOTE130
	select NRFX_GPIOTE131 if HAS_HW_NRF_GPIOTE131
	help
	  Enable GPIO driver for nRF line of MCUs.
```

## drivers/i2c/Kconfig.nrfx
```kconfig
# nrfx I2C support

# Copyright (c) 2018, Nordic Semiconductor ASA
# SPDX-License-Identifier: Apache-2.0

menuconfig I2C_NRFX
	bool "nRF TWI nrfx drivers"
	default y
	depends on SOC_FAMILY_NRF
	help
	  Enable support for nrfx TWI drivers for nRF MCU series.

if I2C_NRFX

config I2C_NRFX_TRANSFER_TIMEOUT
	int "Transfer timeout [ms]"
	default 500
	help
	  Timeout in milliseconds used for each I2C transfer.
	  0 means that the driver should use the K_FOREVER value,
	  i.e. it should wait as long as necessary.

config I2C_0_NRF_TWI
	def_bool HAS_HW_NRF_TWI0
	select NRFX_TWI0
	help
	  Enable nRF TWI Master without EasyDMA on port 0.

config I2C_0_NRF_TWIM
	def_bool HAS_HW_NRF_TWIM0
	select NRFX_TWIM0
	help
	  Enable nRF TWI Master with EasyDMA on port 0.
	  This peripheral accepts transfers from RAM only,
	  if provided buffer is placed in flash, transfer will fail.

config I2C_1_NRF_TWI
	def_bool HAS_HW_NRF_TWI1
	select NRFX_TWI1
	help
	  Enable nRF TWI Master without EasyDMA on port 1.

config I2C_1_NRF_TWIM
	def_bool HAS_HW_NRF_TWIM1
	select NRFX_TWIM1
	help
	  Enable nRF TWI Master with EasyDMA on port 1.
	  This peripheral accepts transfers from RAM only,
	  if provided buffer is placed in flash, transfer will fail.

config I2C_2_NRF_TWIM
	def_bool HAS_HW_NRF_TWIM2
	select NRFX_TWIM2
	help
	  Enable nRF TWI Master with EasyDMA on port 2.
	  This peripheral accepts transfers from RAM only,
	  if provided buffer is placed in flash, transfer will fail.

config I2C_3_NRF_TWIM
	def_bool HAS_HW_NRF_TWIM3
	select NRFX_TWIM3
	help
	  Enable nRF TWI Master with EasyDMA on port 3.
	  This peripheral accepts transfers from RAM only,
	  if provided buffer is placed in flash, transfer will fail.

config I2C_20_NRF_TWIM
	def_bool HAS_HW_NRF_TWIM20
	select NRFX_TWIM20
	help
	  Enable nRF TWI Master with EasyDMA on port 20.
	  This peripheral accepts transfers from RAM only,
	  if provided buffer is placed in flash, transfer will fail.

config I2C_21_NRF_TWIM
	def_bool HAS_HW_NRF_TWIM21
	select NRFX_TWIM21
	help
	  Enable nRF TWI Master with EasyDMA on port 21.
	  This peripheral accepts transfers from RAM only,
	  if provided buffer is placed in flash, transfer will fail.

config I2C_22_NRF_TWIM
	def_bool HAS_HW_NRF_TWIM22
	select NRFX_TWIM22
	help
	  Enable nRF TWI Master with EasyDMA on port 22.
	  This peripheral accepts transfers from RAM only,
	  if provided buffer is placed in flash, transfer will fail.

config I2C_30_NRF_TWIM
	def_bool HAS_HW_NRF_TWIM30
	select NRFX_TWIM30
	help
	  Enable nRF TWI Master with EasyDMA on port 30.
	  This peripheral accepts transfers from RAM only,
	  if provided buffer is placed in flash, transfer will fail.

config I2C_120_NRF_TWIM
	def_bool HAS_HW_NRF_TWIM120
	select NRFX_TWIM120
	help
	  Enable nRF TWI Master with EasyDMA on port 120.
	  This peripheral accepts transfers from RAM only,
	  if provided buffer is placed in flash, transfer will fail.

config I2C_130_NRF_TWIM
	def_bool HAS_HW_NRF_TWIM130
	select NRFX_TWIM130
	help
	  Enable nRF TWI Master with EasyDMA on port 130.
	  This peripheral accepts transfers from RAM only,
	  if provided buffer is placed in flash, transfer will fail.

config I2C_131_NRF_TWIM
	def_bool HAS_HW_NRF_TWIM131
	select NRFX_TWIM131
	help
	  Enable nRF TWI Master with EasyDMA on port 131.
	  This peripheral accepts transfers from RAM only,
	  if provided buffer is placed in flash, transfer will fail.

config I2C_132_NRF_TWIM
	def_bool HAS_HW_NRF_TWIM132
	select NRFX_TWIM132
	help
	  Enable nRF TWI Master with EasyDMA on port 132.
	  This peripheral accepts transfers from RAM only,
	  if provided buffer is placed in flash, transfer will fail.

config I2C_133_NRF_TWIM
	def_bool HAS_HW_NRF_TWIM133
	select NRFX_TWIM133
	help
	  Enable nRF TWI Master with EasyDMA on port 133.
	  This peripheral accepts transfers from RAM only,
	  if provided buffer is placed in flash, transfer will fail.

config I2C_134_NRF_TWIM
	def_bool HAS_HW_NRF_TWIM134
	select NRFX_TWIM134
	help
	  Enable nRF TWI Master with EasyDMA on port 134.
	  This peripheral accepts transfers from RAM only,
	  if provided buffer is placed in flash, transfer will fail.

config I2C_135_NRF_TWIM
	def_bool HAS_HW_NRF_TWIM135
	select NRFX_TWIM135
	help
	  Enable nRF TWI Master with EasyDMA on port 135.
	  This peripheral accepts transfers from RAM only,
	  if provided buffer is placed in flash, transfer will fail.

config I2C_136_NRF_TWIM
	def_bool HAS_HW_NRF_TWIM136
	select NRFX_TWIM136
	help
	  Enable nRF TWI Master with EasyDMA on port 136.
	  This peripheral accepts transfers from RAM only,
	  if provided buffer is placed in flash, transfer will fail.

config I2C_137_NRF_TWIM
	def_bool HAS_HW_NRF_TWIM137
	select NRFX_TWIM137
	help
	  Enable nRF TWI Master with EasyDMA on port 137.
	  This peripheral accepts transfers from RAM only,
	  if provided buffer is placed in flash, transfer will fail.

endif # I2C_NRFX
```

## drivers/pinctrl/Kconfig.nrf
```kconfig
# Copyright (c) 2021 Nordic Semiconductor ASA
# SPDX-License-Identifier: Apache-2.0

config PINCTRL_NRF
	bool "nRF pin controller driver"
	default y
	depends on DT_HAS_NORDIC_NRF_PINCTRL_ENABLED
	select PINCTRL_STORE_REG
	help
	  nRF pin controller driver

config PINCTRL_NRF_ENABLE_CLOCKPIN_FIX
	bool
	default y
	depends on PINCTRL_NRF
	depends on (SOC_NRF54H20 && !HW_REVISION_SOC1) || SOC_NRF9230
```

## drivers/sensor/nrf5/Kconfig
```kconfig
# nRF5 temperature sensor configuration options

# Copyright (c) 2016 ARM Ltd.
# Copyright (c) 2022 Nordic Semiconductor ASA
# SPDX-License-Identifier: Apache-2.0

config TEMP_NRF5_FORCE_ALT
	bool
	depends on SOC_COMPATIBLE_NRF
	help
	  This option can be enabled to force an alternative implementation
	  of the temperature sensor driver.

config TEMP_NRF5
	bool "nRF5 Temperature Sensor"
	default y
	depends on DT_HAS_NORDIC_NRF_TEMP_ENABLED || DT_HAS_NORDIC_NRF_TEMP_NRFS_ENABLED
	depends on HAS_HW_NRF_TEMP || (NRFS && HAS_NRF_TEMP_NRFS)
	depends on MULTITHREADING || TEMP_NRF5_FORCE_ALT
	help
	  Enable driver for nRF5 temperature sensor.

config TEMP_NRF5_TRIGGER
	bool "Trigger mode"
	depends on TEMP_NRF5
	help
	  Enable trigger support for the TEMP_NRF5 sensor.

if TEMP_NRF5_TRIGGER

config TEMP_NRF5_TRIGGER_THREAD_STACK_SIZE
	int "Thread stack size"
	default 1024
	help
	  Stack size of thread used by the driver to handle event.

config TEMP_NRF5_TRIGGER_THREAD_PRIO
	int "Thread priority"
	default 10
	help
	  Priority of thread used by the driver to handle event. This is used through
	  K_PRIO_COOP(x), that means higher value gives lower priority.

endif # TEMP_NRF5_TRIGGER
```

## drivers/sensor/qdec_nrfx/Kconfig.nrfx_qdec_instance
```kconfig
# Copyright (c) 2021, Nordic Semiconductor ASA
# SPDX-License-Identifier: Apache-2.0

DT_COMPAT_NORDIC_NRF_QDEC := nordic,nrf-qdec

config QDEC_$(nrfx_qdec_num)_NRFX
	def_bool $(dt_nodelabel_has_compat,qdec$(nrfx_qdec_num),$(DT_COMPAT_NORDIC_NRF_QDEC))
```

## drivers/serial/Kconfig.nrfx
```kconfig
# nrfx UART configuration

# Copyright (c) 2016 - 2018, Nordic Semiconductor ASA
# SPDX-License-Identifier: Apache-2.0

menuconfig UART_NRFX
	bool "nRF UART nrfx drivers"
	default y
	select SERIAL_HAS_DRIVER
	select SERIAL_SUPPORT_INTERRUPT
	select SERIAL_SUPPORT_ASYNC if !SOC_PLATFORM_HALTIUM
	depends on SOC_FAMILY_NRF
	help
	  Enable support for nrfx UART drivers for nRF MCU series.
	  Peripherals with the same instance ID cannot be used together,
	  e.g. UART_0 and UARTE_0.

if UART_NRFX

config UART_ASYNC_TX_CACHE_SIZE
	int "TX cache buffer size"
	depends on UART_ASYNC_API
	depends on NRF_UARTE_PERIPHERAL
	default 8
	help
	  For UARTE, TX cache buffer is used when provided TX buffer is not located
	  in RAM, because EasyDMA in UARTE peripherals can only transfer data
	  from RAM.

nrfx_uart_num = 0
rsource "Kconfig.nrfx_uart_instance"
nrfx_uart_num = 1
rsource "Kconfig.nrfx_uart_instance"
nrfx_uart_num = 2
rsource "Kconfig.nrfx_uart_instance"
nrfx_uart_num = 3
rsource "Kconfig.nrfx_uart_instance"
nrfx_uart_num = 00
rsource "Kconfig.nrfx_uart_instance"
nrfx_uart_num = 20
rsource "Kconfig.nrfx_uart_instance"
nrfx_uart_num = 21
rsource "Kconfig.nrfx_uart_instance"
nrfx_uart_num = 22
rsource "Kconfig.nrfx_uart_instance"
nrfx_uart_num = 30
rsource "Kconfig.nrfx_uart_instance"
nrfx_uart_num = 130
rsource "Kconfig.nrfx_uart_instance"
nrfx_uart_num = 131
rsource "Kconfig.nrfx_uart_instance"
nrfx_uart_num = 132
rsource "Kconfig.nrfx_uart_instance"
nrfx_uart_num = 133
rsource "Kconfig.nrfx_uart_instance"
nrfx_uart_num = 134
rsource "Kconfig.nrfx_uart_instance"
nrfx_uart_num = 135
rsource "Kconfig.nrfx_uart_instance"
nrfx_uart_num = 136
rsource "Kconfig.nrfx_uart_instance"
nrfx_uart_num = 137
rsource "Kconfig.nrfx_uart_instance"

config NRFX_TIMER0
	default y
	depends on UART_0_NRF_HW_ASYNC_TIMER = 0 || UART_1_NRF_HW_ASYNC_TIMER = 0 || \
		   UART_2_NRF_HW_ASYNC_TIMER = 0 || UART_3_NRF_HW_ASYNC_TIMER = 0 || \
		   UART_130_NRF_HW_ASYNC_TIMER = 0 || UART_131_NRF_HW_ASYNC_TIMER = 0 || \
		   UART_132_NRF_HW_ASYNC_TIMER = 0 || UART_133_NRF_HW_ASYNC_TIMER = 0 || \
		   UART_134_NRF_HW_ASYNC_TIMER = 0 || UART_135_NRF_HW_ASYNC_TIMER = 0 || \
		   UART_136_NRF_HW_ASYNC_TIMER = 0 || UART_137_NRF_HW_ASYNC_TIMER = 0 || \
		   UART_00_NRF_HW_ASYNC_TIMER = 0 || UART_20_NRF_HW_ASYNC_TIMER = 0 || \
		   UART_21_NRF_HW_ASYNC_TIMER = 0 || UART_22_NRF_HW_ASYNC_TIMER = 0 || \
		   UART_30_NRF_HW_ASYNC_TIMER = 0

config NRFX_TIMER1
	default y
	depends on UART_0_NRF_HW_ASYNC_TIMER = 1 || UART_1_NRF_HW_ASYNC_TIMER = 1 || \
		   UART_2_NRF_HW_ASYNC_TIMER = 1 || UART_3_NRF_HW_ASYNC_TIMER = 1 || \
		   UART_130_NRF_HW_ASYNC_TIMER = 1 || UART_131_NRF_HW_ASYNC_TIMER = 1 || \
		   UART_132_NRF_HW_ASYNC_TIMER = 1 || UART_133_NRF_HW_ASYNC_TIMER = 1 || \
		   UART_134_NRF_HW_ASYNC_TIMER = 1 || UART_135_NRF_HW_ASYNC_TIMER = 1 || \
		   UART_136_NRF_HW_ASYNC_TIMER = 1 || UART_137_NRF_HW_ASYNC_TIMER = 1 || \
		   UART_00_NRF_HW_ASYNC_TIMER = 1 || UART_20_NRF_HW_ASYNC_TIMER = 1 || \
		   UART_21_NRF_HW_ASYNC_TIMER = 1 || UART_22_NRF_HW_ASYNC_TIMER = 1 || \
		   UART_30_NRF_HW_ASYNC_TIMER = 1

config NRFX_TIMER2
	default y
	depends on UART_0_NRF_HW_ASYNC_TIMER = 2 || UART_1_NRF_HW_ASYNC_TIMER = 2 || \
		   UART_2_NRF_HW_ASYNC_TIMER = 2 || UART_3_NRF_HW_ASYNC_TIMER = 2 || \
		   UART_130_NRF_HW_ASYNC_TIMER = 2 || UART_131_NRF_HW_ASYNC_TIMER = 2 || \
		   UART_132_NRF_HW_ASYNC_TIMER = 2 || UART_133_NRF_HW_ASYNC_TIMER = 2 || \
		   UART_134_NRF_HW_ASYNC_TIMER = 2 || UART_135_NRF_HW_ASYNC_TIMER = 2 || \
		   UART_136_NRF_HW_ASYNC_TIMER = 2 || UART_137_NRF_HW_ASYNC_TIMER = 2 || \
		   UART_00_NRF_HW_ASYNC_TIMER = 2 || UART_20_NRF_HW_ASYNC_TIMER = 2 || \
		   UART_21_NRF_HW_ASYNC_TIMER = 2 || UART_22_NRF_HW_ASYNC_TIMER = 2 || \
		   UART_30_NRF_HW_ASYNC_TIMER = 2

config NRFX_TIMER3
	default y
	depends on UART_0_NRF_HW_ASYNC_TIMER = 3 || UART_1_NRF_HW_ASYNC_TIMER = 3 || \
		   UART_2_NRF_HW_ASYNC_TIMER = 3 || UART_3_NRF_HW_ASYNC_TIMER = 3 || \
		   UART_130_NRF_HW_ASYNC_TIMER = 3 || UART_131_NRF_HW_ASYNC_TIMER = 3 || \
		   UART_132_NRF_HW_ASYNC_TIMER = 3 || UART_133_NRF_HW_ASYNC_TIMER = 3 || \
		   UART_134_NRF_HW_ASYNC_TIMER = 3 || UART_135_NRF_HW_ASYNC_TIMER = 3 || \
		   UART_136_NRF_HW_ASYNC_TIMER = 3 || UART_137_NRF_HW_ASYNC_TIMER = 3 || \
		   UART_00_NRF_HW_ASYNC_TIMER = 3 || UART_20_NRF_HW_ASYNC_TIMER = 3 || \
		   UART_21_NRF_HW_ASYNC_TIMER = 3 || UART_22_NRF_HW_ASYNC_TIMER = 3 || \
		   UART_30_NRF_HW_ASYNC_TIMER = 3

config NRFX_TIMER4
	default y
	depends on UART_0_NRF_HW_ASYNC_TIMER = 4 || UART_1_NRF_HW_ASYNC_TIMER = 4 || \
		   UART_2_NRF_HW_ASYNC_TIMER = 4 || UART_3_NRF_HW_ASYNC_TIMER = 4 || \
		   UART_130_NRF_HW_ASYNC_TIMER = 4 || UART_131_NRF_HW_ASYNC_TIMER = 4 || \
		   UART_132_NRF_HW_ASYNC_TIMER = 4 || UART_133_NRF_HW_ASYNC_TIMER = 4 || \
		   UART_134_NRF_HW_ASYNC_TIMER = 4 || UART_135_NRF_HW_ASYNC_TIMER = 4 || \
		   UART_136_NRF_HW_ASYNC_TIMER = 4 || UART_137_NRF_HW_ASYNC_TIMER = 4 || \
		   UART_00_NRF_HW_ASYNC_TIMER = 4 || UART_20_NRF_HW_ASYNC_TIMER = 4 || \
		   UART_21_NRF_HW_ASYNC_TIMER = 4 || UART_22_NRF_HW_ASYNC_TIMER = 4 || \
		   UART_30_NRF_HW_ASYNC_TIMER = 4

config UARTE_NRF_HW_ASYNC
	def_bool y
	depends on UART_0_NRF_HW_ASYNC || UART_1_NRF_HW_ASYNC || UART_2_NRF_HW_ASYNC || \
			   UART_3_NRF_HW_ASYNC || UART_130_NRF_HW_ASYNC || UART_131_NRF_HW_ASYNC || \
			   UART_132_NRF_HW_ASYNC || UART_133_NRF_HW_ASYNC || UART_134_NRF_HW_ASYNC || \
			   UART_135_NRF_HW_ASYNC || UART_136_NRF_HW_ASYNC || UART_00_NRF_HW_ASYNC || \
			   UART_20_NRF_HW_ASYNC || UART_21_NRF_HW_ASYNC || UART_22_NRF_HW_ASYNC || \
			   UART_30_NRF_HW_ASYNC
	select NRFX_PPI if HAS_HW_NRF_PPI
	select NRFX_DPPI if HAS_HW_NRF_DPPIC

config UART_ENHANCED_POLL_OUT
	def_bool y
	depends on UART_0_ENHANCED_POLL_OUT || UART_1_ENHANCED_POLL_OUT || \
			   UART_2_ENHANCED_POLL_OUT || UART_3_ENHANCED_POLL_OUT || \
			   UART_130_ENHANCED_POLL_OUT || UART_131_ENHANCED_POLL_OUT || \
			   UART_132_ENHANCED_POLL_OUT || UART_133_ENHANCED_POLL_OUT || \
			   UART_134_ENHANCED_POLL_OUT || UART_135_ENHANCED_POLL_OUT || \
			   UART_136_ENHANCED_POLL_OUT || UART_00_ENHANCED_POLL_OUT || \
			   UART_20_ENHANCED_POLL_OUT || UART_21_ENHANCED_POLL_OUT || \
			   UART_22_ENHANCED_POLL_OUT || UART_30_ENHANCED_POLL_OUT
	select NRFX_PPI if HAS_HW_NRF_PPI
	select NRFX_DPPI if HAS_HW_NRF_DPPIC

config NRF_UART_PERIPHERAL
	bool

config NRF_UARTE_PERIPHERAL
	bool

endif # UART_NRFX
```
