## drivers/serial/Kconfig.nrfx_uart_instance
```kconfig
#nRF UART(E) instance configuration

# Copyright (c) 2021 Nordic Semiconductor ASA
# SPDX-License-Identifier: Apache-2.0

if $(nrfx_uart_num) = 0
config UART_$(nrfx_uart_num)_NRF_UART
	def_bool HAS_HW_NRF_UART$(nrfx_uart_num)
	depends on DT_HAS_NORDIC_NRF_UART_ENABLED
	select NRF_UART_PERIPHERAL
	help
	  Enable nRF UART without EasyDMA on port $(nrfx_uart_num).
endif

config UART_$(nrfx_uart_num)_NRF_UARTE
	def_bool HAS_HW_NRF_UARTE$(nrfx_uart_num)
	depends on DT_HAS_NORDIC_NRF_UARTE_ENABLED || DT_HAS_NORDIC_NRF_UARTE_V2_ENABLED
	select NRF_UARTE_PERIPHERAL
	help
	  Enable nRF UART with EasyDMA on port $(nrfx_uart_num).

if UART_$(nrfx_uart_num)_NRF_UART || UART_$(nrfx_uart_num)_NRF_UARTE

config UART_$(nrfx_uart_num)_ENHANCED_POLL_OUT
	bool "Efficient poll out on port $(nrfx_uart_num)"
	depends on !(SOC_PLATFORM_HALTIUM || SOC_PLATFORM_NRF54L)
	default y
	depends on UART_$(nrfx_uart_num)_NRF_UARTE
	help
	  When enabled, polling out does not trigger interrupt which stops TX.
	  Feature uses a PPI channel.

config UART_$(nrfx_uart_num)_INTERRUPT_DRIVEN
	bool "Interrupt support on port $(nrfx_uart_num)"
	depends on UART_INTERRUPT_DRIVEN
	default y
	help
	  This option enables UART interrupt support on port $(nrfx_uart_num).

config UART_$(nrfx_uart_num)_ASYNC
	bool "Asynchronous API support on port $(nrfx_uart_num)"
	depends on UART_ASYNC_API && !UART_$(nrfx_uart_num)_INTERRUPT_DRIVEN
	default y
	help
	  This option enables UART Asynchronous API support on port $(nrfx_uart_num).

config UART_$(nrfx_uart_num)_NRF_PARITY_BIT
	bool "Parity bit"
	help
	  Enable parity bit.

config UART_$(nrfx_uart_num)_NRF_TX_BUFFER_SIZE
	int "Size of RAM buffer"
	depends on UART_$(nrfx_uart_num)_NRF_UARTE
	range 1 65535
	default 32
	help
	  Size of the transmit buffer for API function: fifo_fill.
	  This value is limited by range of TXD.MAXCNT register for
	  particular SoC.

config UART_$(nrfx_uart_num)_NRF_HW_ASYNC
	bool "Use hardware RX byte counting"
	depends on UART_$(nrfx_uart_num)_NRF_UARTE
	depends on UART_ASYNC_API
	help
	  If default driver uses interrupts to count incoming bytes, it is possible
	  that with higher speeds and/or high cpu load some data can be lost.
	  It is recommended to use hardware byte counting in such scenarios.
	  Hardware RX byte counting requires timer instance and one PPI channel

config UART_$(nrfx_uart_num)_NRF_ASYNC_LOW_POWER
	bool "Low power mode"
	depends on UART_$(nrfx_uart_num)_NRF_UARTE
	depends on UART_ASYNC_API
	help
	  When enabled, UARTE is enabled before each TX or RX usage and disabled
	  when not used. Disabling UARTE while in idle allows to achieve lowest
	  power consumption. It is only feasible if receiver is not always on.

config UART_$(nrfx_uart_num)_NRF_HW_ASYNC_TIMER
	int "Timer instance"
	depends on UART_$(nrfx_uart_num)_NRF_HW_ASYNC

config UART_$(nrfx_uart_num)_GPIO_MANAGEMENT
	bool "GPIO management on port $(nrfx_uart_num)"
	depends on PM_DEVICE
	default y
	help
	  If enabled, the driver will configure the GPIOs used by the uart to
	  their default configuration when device is powered down. The GPIOs
	  will be configured back to correct state when UART is powered up.

endif # UART_$(nrfx_uart_num)_NRF_UART || UART_$(nrfx_uart_num)_NRF_UARTE
```

## drivers/spi/Kconfig.nrfx
```kconfig
# Copyright (c) 2017 - 2018, Nordic Semiconductor ASA
# SPDX-License-Identifier: Apache-2.0

menuconfig SPI_NRFX
	bool "nRF SPI nrfx drivers"
	default y
	depends on SOC_FAMILY_NRF
	depends on MULTITHREADING
	help
	  Enable support for nrfx SPI drivers for nRF MCU series.

if SPI_NRFX

config SOC_NRF52832_ALLOW_SPIM_DESPITE_PAN_58
	depends on SOC_NRF52832
	bool "Allow enabling the SPIM driver despite PAN 58"
	help
	  Allow enabling the nRF SPI Master with EasyDMA, despite
	  Product Anomaly Notice 58 (SPIM: An additional byte is
	  clocked out when RXD.MAXCNT == 1 and TXD.MAXCNT <= 1).
	  Without this override, the SPI Master is only available
	  without EasyDMA. Note that the 'SPIM' and 'SPIS' drivers
	  use EasyDMA, while the 'SPI' driver does not.
	  When used in conjunction with nRF SPIM Devicetree property
	  'anomaly-58-workaround' a workaround can be enabled per SPIM
	  instance.  If you are certain that transactions with
	  RXD.MAXCNT == 1 and TXD.MAXCNT <= 1 will NOT be executed
	  then nRF52832 PPI and GPIOTE resources can be saved by not
	  enabling 'anomaly-58-workaround' via the Devicetree.

config SPI_0_NRF_SPI
	def_bool HAS_HW_NRF_SPI0
	select NRFX_SPI0
	help
	  Enable nRF SPI Master without EasyDMA on port 0.

config SPI_0_NRF_SPIM
	def_bool HAS_HW_NRF_SPIM0
	# This driver is not available for nRF52832 because of Product Anomaly 58
	# (SPIM: An additional byte is clocked out when RXD.MAXCNT == 1 and TXD.MAXCNT <= 1)
	# Allow the 'EasyDMA' driver only if this automatic safety-disable is overridden
	depends on (!SOC_NRF52832 || SOC_NRF52832_ALLOW_SPIM_DESPITE_PAN_58)
	select NRFX_SPIM0
	help
	  Enable nRF SPI Master with EasyDMA on port 0.

config SPI_0_NRF_SPIS
	def_bool  HAS_HW_NRF_SPIS0
	depends on SPI_SLAVE
	select NRFX_SPIS0
	help
	  Enable nRF SPI Slave with EasyDMA on port 0.
	  Due to hardware limitations the implementation supports only simple
	  buffers (consisting of one part) located in RAM.

config SPI_1_NRF_SPI
	def_bool  HAS_HW_NRF_SPI1
	select NRFX_SPI1
	help
	  Enable nRF SPI Master without EasyDMA on port 1.

config SPI_1_NRF_SPIM
	def_bool HAS_HW_NRF_SPIM1
	# This driver is not available for nRF52832 because of Product Anomaly 58
	# (SPIM: An additional byte is clocked out when RXD.MAXCNT == 1 and TXD.MAXCNT <= 1)
	# Allow the 'EasyDMA' driver only if this automatic safety-disable is overridden
	depends on (!SOC_NRF52832 || SOC_NRF52832_ALLOW_SPIM_DESPITE_PAN_58)
	select NRFX_SPIM1
	help
	  Enable nRF SPI Master with EasyDMA on port 1.

config SPI_1_NRF_SPIS
	def_bool HAS_HW_NRF_SPIS1
	depends on SPI_SLAVE
	select NRFX_SPIS1
	help
	  Enable nRF SPI Slave with EasyDMA on port 1.
	  Due to hardware limitations the implementation supports only simple
	  buffers (consisting of one part) located in RAM.

config SPI_2_NRF_SPI
	def_bool HAS_HW_NRF_SPI2
	select NRFX_SPI2
	help
	  Enable nRF SPI Master without EasyDMA on port 2.

config SPI_2_NRF_SPIM
	def_bool HAS_HW_NRF_SPIM2
	# This driver is not available for nRF52832 because of Product Anomaly 58
	# (SPIM: An additional byte is clocked out when RXD.MAXCNT == 1 and TXD.MAXCNT <= 1)
	# Allow the 'EasyDMA' driver only if this automatic safety-disable is overridden
	depends on (!SOC_NRF52832 || SOC_NRF52832_ALLOW_SPIM_DESPITE_PAN_58)
	select NRFX_SPIM2
	help
	  Enable nRF SPI Master with EasyDMA on port 2.

config SPI_2_NRF_SPIS
	def_bool HAS_HW_NRF_SPIS2
	depends on SPI_SLAVE
	select NRFX_SPIS2
	help
	  Enable nRF SPI Slave with EasyDMA on port 2.
	  Due to hardware limitations the implementation supports only simple
	  buffers (consisting of one part) located in RAM.

config SPI_3_NRF_SPIM
	def_bool HAS_HW_NRF_SPIM3
	select NRFX_SPIM3
	help
	  Enable nRF SPI Master with EasyDMA on port 3.

config SPI_3_NRF_SPIS
	def_bool HAS_HW_NRF_SPIS3
	depends on SPI_SLAVE
	select NRFX_SPIS3
	help
	  Enable nRF SPI Slave with EasyDMA on port 3.
	  Due to hardware limitations the implementation supports only simple
	  buffers (consisting of one part) located in RAM.

config SPI_4_NRF_SPIM
	def_bool HAS_HW_NRF_SPIM4
	select NRFX_SPIM4
	help
	  Enable nRF SPI Master with EasyDMA on port 4.

config SPI_4_NRF_RX_DELAY
	int "SPIM4 MISO sampling delay"
	depends on SPI_4_NRF_SPIM && SOC_NRF5340_CPUAPP
	range 0 7
	default 2
	help
	  Number of 64 MHz clock cycles (15.625 ns) delay from the sampling
	  edge of SCK (leading or trailing, depending on the CPHA setting used)
	  until the input serial data on MISO is actually sampled.

config SPI_120_NRF_SPIM
	def_bool HAS_HW_NRF_SPIM120
	select NRFX_SPIM120
	help
	  Enable nRF SPI Master with EasyDMA on port 120.

config SPI_121_NRF_SPIM
	def_bool HAS_HW_NRF_SPIM121
	select NRFX_SPIM121
	help
	  Enable nRF SPI Master with EasyDMA on port 121.

config SPI_130_NRF_SPIM
	def_bool HAS_HW_NRF_SPIM130
	select NRFX_SPIM130
	help
	  Enable nRF SPI Master with EasyDMA on port 130.

config SPI_131_NRF_SPIM
	def_bool HAS_HW_NRF_SPIM131
	select NRFX_SPIM131
	help
	  Enable nRF SPI Master with EasyDMA on port 131.

config SPI_132_NRF_SPIM
	def_bool HAS_HW_NRF_SPIM132
	select NRFX_SPIM132
	help
	  Enable nRF SPI Master with EasyDMA on port 132.

config SPI_133_NRF_SPIM
	def_bool HAS_HW_NRF_SPIM133
	select NRFX_SPIM133
	help
	  Enable nRF SPI Master with EasyDMA on port 133.

config SPI_134_NRF_SPIM
	def_bool HAS_HW_NRF_SPIM134
	select NRFX_SPIM134
	help
	  Enable nRF SPI Master with EasyDMA on port 134.

config SPI_135_NRF_SPIM
	def_bool HAS_HW_NRF_SPIM135
	select NRFX_SPIM135
	help
	  Enable nRF SPI Master with EasyDMA on port 135.

config SPI_136_NRF_SPIM
	def_bool HAS_HW_NRF_SPIM136
	select NRFX_SPIM136
	help
	  Enable nRF SPI Master with EasyDMA on port 136.

config SPI_137_NRF_SPIM
	def_bool HAS_HW_NRF_SPIM137
	select NRFX_SPIM137
	help
	  Enable nRF SPI Master with EasyDMA on port 137.

config SPI_NRFX_RAM_BUFFER_SIZE
	int "Size of RAM buffers for SPIM peripherals"
	default 8
	depends on NRFX_SPIM
	help
	  SPIM peripherals cannot transmit data directly from flash. Therefore,
	  a buffer in RAM needs to be provided for each instance of SPI driver
	  using SPIM peripheral, so that the driver can copy there a chunk of
	  data from flash and transmit it.
	  The size is specified in bytes. A size of 0 means that this feature
	  should be disabled, and the application must then take care of not
	  supplying buffers located in flash to the driver, otherwise such
	  transfers will fail.

endif # SPI_NRFX
```

## dts/bindings/crypto/nordic,nrf-cracen.yaml
```yaml
# Copyright (c) 2023, Nordic Semiconductor ASA
# SPDX-License-Identifier: Apache-2.0

description: Nordic Control Interface for CRACEN 

compatible: "nordic,nrf-cracen"

include: base.yaml

properties:
    reg:
      required: false
```

## modules/Kconfig.nrfs
```kconfig
# Copyright (c) 2020, Nordic Semiconductor ASA
# SPDX-License-Identifier: Apache-2.0

config NRFS
	bool "nRF Services Support"
	help
	  This option enables the nRF Services library

config NRFS_LOCAL_DOMAIN
	bool "nRF Services Local Domain Support"
	imply NRFS
	help
	  This option enables the nRF Services Local Domain libraries

config NRFS_BACKEND_PRISM_DISPATCHER
	bool "PRISM Dispatcher"

config NRFS_BACKEND_IPC_SERVICE
	bool "Ipc service backend for nrfs"
	imply IPC_SERVICE
	imply IPC_SERVICE_BACKEND_ICMSG
	imply MBOX
	imply MBOX_NRFX_IDS
	imply EVENTS
	imply REBOOT
	help
	  Ipc service backend for nrfs

config NRFS_MAX_BACKEND_PACKET_SIZE
	int "Maximum ipc data packet size in bytes"
	range 8 128
	default 32

config NRFS_BACKEND_RX_TASK_STACK_SIZE
	int "Stack size used for incoming messages task"
	range 128 16384
	default 512

config NRFS_BACKEND_TX_TASK_STACK_SIZE
	int "Stack size used for outgoing messages task"
	range 128 16384
	default 2048 if LOG
	default 512

config NRFS_BACKEND_RX_TASK_PRIORITY
	int "Priority of rx backend task"
	range -16 NUM_PREEMPT_PRIORITIES
	default 0

config NRFS_BACKEND_TX_TASK_PRIORITY
	int "Priority of tx backend task"
	range -16 NUM_PREEMPT_PRIORITIES
	default 0

config NRFS_BACKEND_RX_MSG_QUEUE_SIZE
	int "Size of rx buffer message queue size"
	range 1 16
	default 8

config NRFS_BACKEND_TX_MSG_QUEUE_SIZE
	int "Size of tx buffer message queue size"
	range 1 16
	default 8

config NRFS_BACKEND_TX_MAX_RETRIES
	int "Max number of retries when sending message"
	range 0 100
	default 5

config NRFS_BACKEND_TX_RETRY_DELAY_US
	int "Delay in us that will be added between send retries"
	range 0 1000000
	default 10

config NRFS_BACKEND_RX_QUEUE_MAX_WAIT_US
	int "Maximum wait time to wait when putting data to rq queue in usec"
	range 0 1000000
	default 10

config NRFS_BACKEND_SERVICE_START_DELAY_MS
	int "Delay before backend initialization and start in ms"
	range 0 1000000
	default 10 if EMULATOR_SYSTEMC
	default 0
```

## modules/Kconfig.prism-dispatcher
```kconfig
# Copyright (c) 2020, Nordic Semiconductor ASA
# SPDX-License-Identifier: Apache-2.0

config PRISM_DISPATCHER
	bool "PRISM Dispatcher Support"
	help
	  This option enables the PRISM Dispatcher library

if PRISM_DISPATCHER

choice
	prompt "PRISM Dispatcher algorithm"
	default PRISM_DISPATCHER_ALGO_SINGLEBUF

config PRISM_DISPATCHER_ALGO_SINGLEBUF
	bool "Enable algorithm with single message buffer"

endchoice

choice
	prompt "PRISM Dispatcher IPC transport backend"
	default PRISM_DISPATCHER_BACKEND_OPENAMP

config PRISM_DISPATCHER_BACKEND_OPENAMP
	select OPENAMP_MULTIINSTANCE
	bool "Enable OpenAMP as backend"

config PRISM_DISPATCHER_BACKEND_MOCK
	bool "Enable mocked backend for unit testing purposes"

endchoice

config PRISM_DISPATCHER_APP_ENABLED
	default n
	bool "Enable communication channel with Application Domain"

config PRISM_DISPATCHER_NET_ENABLED
	default n
	bool "Enable communication channel with Network Domain"

config PRISM_DISPATCHER_SECURE_ENABLED
	default n
	bool "Enable communication channel with Secure Domain"

config PRISM_DISPATCHER_MODEM_ENABLED
	default n
	bool "Enable communication channel with Modem Domain"

config PRISM_DISPATCHER_SYSCTRL_ENABLED
	default n
	bool "Enable communication channel with SysCtrl Domain"

config PRISM_DISPATCHER_EPT_COUNT
	default 1
	int "Total number of endpoints used in the application"

config PRISM_DISPATCHER_MSG_SIZE
	default 512
	int "Maximum size of payload that may arrive over IPC transport"

config PRISM_DISPATCHER_BACKEND_OPENAMP_VRING_SIZE
	depends on PRISM_DISPATCHER_BACKEND_OPENAMP
	default 8
	int "Number of buffers in the VirtQueue"

endif # PRISM_DISPATCHER
```

## samples/benchmarks/coremark/Kconfig
```kconfig
#
# Copyright (c) 2023 Nordic Semiconductor ASA
#
# SPDX-License-Identifier: Apache-2.0
#

menu "Zephyr Kernel"
  source "Kconfig.zephyr"
endmenu

menu "CoreMark sample"

config APP_MODE_FLASH_AND_RUN
	bool "Run CoreMark benchmark on start up"
	help
	  If enabled, CoreMark will start execution immediately after CPU start up.
	  Otherwise, it will wait button to be pressed.

config APP_BUILD_MULTICORE
	bool "Build sample for all available cores"
	depends on SOC_NRF5340_CPUAPP || SOC_NRF54H20_CPUAPP
	default y if (BOARD_NRF5340DK_NRF5340_CPUAPP || BOARD_NRF5340DK_NRF5340_CPUAPP_NS)
	default y if BOARD_NRF54H20DK_NRF54H20_CPUAPP
	select PARTITION_MANAGER_ENABLED if SOC_NRF5340_CPUAPP
	select BOARD_ENABLE_CPUNET if (BOARD_NRF5340DK_NRF5340_CPUAPP || BOARD_NRF5340DK_NRF5340_CPUAPP_NS)
	help
	  For multicore SoCs this option allows to build application for all
	  cores available on the target.

config APP_REMOTE_BOARD
	string
	depends on APP_BUILD_MULTICORE
	default DOMAIN_CPUNET_BOARD if (BOARD_NRF5340DK_NRF5340_CPUAPP || BOARD_NRF5340DK_NRF5340_CPUAPP_NS)
	default "nrf54h20dk_nrf54h20_cpurad@soc1" if (BOARD_NRF54H20DK_NRF54H20_CPUAPP && HW_REVISION_SOC1)

config APP_STM_LOGGING
	depends on SOC_NRF54H20
	bool "STM logging"

if APP_STM_LOGGING

choice APP_STM_LOGGING_TYPE
	prompt "STM Logging"
	default APP_STM_LOGGING_OFF

config APP_STM_LOGGING_OFF
	bool "Logging disabled"
	help
	  Logging is disabled.

config APP_STM_LOGGING_FSC_FRONTEND
	bool "Human-readable"
	help
	  Logging to STM frontend is enabled on secure domain, application core
	  and PPR. Human readable logs are printed on UART owned by the secure domain.

endchoice

endif

endmenu
```

## samples/benchmarks/coremark/boards/nrf54h20dk_nrf54h20_cpuapp_soc1.conf
```kconfig
CONFIG_NRF_REGTOOL_TOML_CONFIG_FILES="uicr/nrf54h20dk_nrf54h20_cpuapp.toml"
CONFIG_SERIAL=y
CONFIG_RTT_CONSOLE=n
CONFIG_USE_SEGGER_RTT=n
CONFIG_COREMARK_ITERATIONS=10000
```
