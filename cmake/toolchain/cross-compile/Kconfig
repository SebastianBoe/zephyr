## drivers/random/Kconfig.nrf5
```kconfig
# Kconfig.nrf5 - nRF5 random number generator driver configuration
#
# Copyright (c) 2017 Exati Tecnologia Ltda.
#
# SPDX-License-Identifier: Apache-2.0

# FIXME: nRF5 RNG driver can't co-exist with Bluetooth's HAL implementation yet
menuconfig RANDOM_NRF5_RNG
	bool "nRF5 RNG driver"
	depends on RANDOM_GENERATOR && !BT
	select RANDOM_HAS_DRIVER
	help
	  This option enables the RNG peripheral, which is a random number
	  generator, based on internal thermal noise, that provides a
	  random 8-bit value to the host when read.

	  Run time per byte is as follows:
	    nRF51822 - 167 uS
	    nRF52832 - 30 uS
	    nRF52840 - 30 uS

config RANDOM_NRF5_BIAS_CORRECTION
	bool "Enable bias correction (uniform distribution)"
	depends on RANDOM_NRF5_RNG
	help
	  This option enables the RNG bias correction, which guarantees a
	  uniform distribution of 0 and 1. When this option is enabled, the time
	  to generate a byte cannot be guaranteed.

	  When this option is enabled, run time per byte is usually as follows:
	    nRF51822 - 677 uS
	    nRF52832 - 120 uS
	    nRF52840 - 120 uS
```

## dts/bindings/modem/wnc,m14a2a.yaml
```yaml
#
# Copyright (c) 2018, Foundries.io
#
# SPDX-License-Identifier: Apache-2.0
#
---
title: WNC-M14A2A LTE-M Modem
version: 0.1

description: >
    This is a representation of the WNC-M14A2A LTE-M modem.

inherits:
    !include uart-device.yaml

properties:
    compatible:
      type: string
      category: required
      constraint: "wnc,m14a2a"
      generation: define

    mdm-boot-mode-sel-gpios-gpio:
      type: compound
      category: required
      generation: define, use-prop-name

    mdm-power-gpios-gpio:
      type: compound
      category: required
      generation: define, use-prop-name

    mdm-keep-awake-gpios-gpio:
      type: compound
      category: required
      generation: define, use-prop-name

    mdm-reset-gpios-gpio:
      type: compound
      category: required
      generation: define, use-prop-name

    mdm-shld-trans-ena-gpios-gpio:
      type: compound
      category: required
      generation: define, use-prop-name

    mdm-send-ok-gpios-gpio:
      type: compound
      category: optional
      description: UART RTS pin if no HW flow control (set to always enabled)
      generation: define, use-prop-name
...
```

## ext/lib/openthread/Kconfig
```kconfig
# Kconfig - OpenThread platform
#
#
# Copyright (c) 2017 Nordic Semiconductor ASA
#
# SPDX-License-Identifier: Apache-2.0
#

config OPENTHREAD_PLAT
bool
depends on NET_L2_OPENTHREAD
default n
help
This option enables OpenThread platform

if OPENTHREAD_PLAT

menuconfig OPENTHREAD_DEBUG
bool
default n
prompt "OpenThread stack log support"
help
This option enables log support for OpenThread

if OPENTHREAD_DEBUG

choice
prompt "OpenThread stack log level"
depends on OPENTHREAD_L2_DEBUG
help
This option selects log level for OpenThread stack.

config OPENTHREAD_LOG_LEVEL_ERROR
bool "Error"
config OPENTHREAD_LOG_LEVEL_WARNING
bool "Warning"
config OPENTHREAD_LOG_LEVEL_INFO
bool "Info"
config OPENTHREAD_LOG_LEVEL_DEBUG
bool "Debug"
endchoice

endif

endif

config	OPENTHREAD_LOG_LEVEL
int 
default 0
default 1 if OPENTHREAD_LOG_LEVEL_ERROR
default 2 if OPENTHREAD_LOG_LEVEL_WARNING
default 3 if OPENTHREAD_LOG_LEVEL_INFO
default 4 if OPENTHREAD_LOG_LEVEL_DEBUG	  
```

## samples/application_development/out_of_tree_board/sample.yaml
```yaml
sample:
  description: Sample that uses an out-of-tree board
  name: Out-of-tree board
  platforms: all
```

## samples/subsys/usb/webusb/sample.yaml
```yaml
sample:
  description: TBD
  name: TBD
tests:
  - test_x86:
      build_only: true
      depends_on: usb_device
      tags: usb
```

## subsys/net/ip/l2/openthread/Kconfig
```kconfig
# Kconfig - OpenThread driver configuration options
#
#
# Copyright (c) 2017 Nordic Semiconductor ASA
#
# SPDX-License-Identifier: Apache-2.0
#

#
# OpenThread options
#
menuconfig NET_L2_OPENTHREAD
	bool
	prompt "OpenThread L2"
	depends on FLASH
	depends on FLASH_PAGE_LAYOUT
	depends on RANDOM_GENERATOR
	select OPENTHREAD_PLAT
	select NETWORKING_WITH_15_4

if NET_L2_OPENTHREAD

menuconfig OPENTHREAD_L2_DEBUG
	bool
	prompt "OpenThread L2 log support"
	help
		This option enables log support for OpenThread

if OPENTHREAD_L2_DEBUG
choice
	prompt "OpenThread L2 log level"
	depends on OPENTHREAD_L2_DEBUG
	help
	  This option selects log level for OpenThread driver.

	config OPENTHREAD_L2_LOG_LEVEL_ERROR
		bool "Error"
	config OPENTHREAD_L2_LOG_LEVEL_WARNING
		bool "Warning"
	config OPENTHREAD_L2_LOG_LEVEL_INFO
		bool "Info"
	config OPENTHREAD_L2_LOG_LEVEL_DEBUG
		bool "Debug"
endchoice

config OPENTHREAD_L2_DEBUG_DUMP_15_4
	bool
	prompt "Dump 802.15.4 packets"
	help
		This option enables dumping of 802.15.4 packets

config OPENTHREAD_L2_DEBUG_DUMP_IPV6
	bool
	prompt "Dump IPv6 packets"
	help
		This option enables dumping of IPv6 packets

endif

config OPENTHREAD_PKT_LIST_SIZE
	int
	prompt "List size for Ip6 packet buffering"
	default 10

config	OPENTHREAD_NAME
	string "OpenThread Driver name"
	default "openthread"
	help
	  This option sets the driver name

config	OPENTHREAD_L2_LOG_LEVEL
	int
	default 0
	default 1 if OPENTHREAD_L2_LOG_LEVEL_ERROR
	default 2 if OPENTHREAD_L2_LOG_LEVEL_WARNING
	default 3 if OPENTHREAD_L2_LOG_LEVEL_INFO
	default 4 if OPENTHREAD_L2_LOG_LEVEL_DEBUG

config OPENTHREAD_PANID
	int
	prompt "Default PAN ID"
	default 43981

config OPENTHREAD_CHANNEL
	int
	prompt "Default Channel"
	default 11

choice
	prompt "OpenThread device type"
	help
		This option selects Thread network device type

	config OPENTHREAD_FTD
		bool "FTD - Full Thread Device"
	config OPENTHREAD_MTD
		bool "MTD - Minimal Thread Device"
endchoice

config OPENTHREAD_SHELL
	bool
	prompt "Enable OpenThread shell"
	select CONSOLE_SHELL
	default y

config OPENTHREAD_DIAG
	bool
	prompt "Diagnostic functions support"

config OPENTHREAD_COMMISSIONER
	bool
	prompt "Commisioner functions support"

config OPENTHREAD_JOINER
	bool
	prompt "Joiner functions support"

config OPENTHREAD_JAM_DETECTION
	bool
	prompt "Jam detection support"

config OT_PLAT_FLASH_DEVICE_NAME
	string
	prompt "Flash device name"
	default "NRF5_FLASH"

config OT_PLAT_IEEE802154_RADIO_DEVICE_NAME
	string
	prompt "IEEE802.15.4 radio device name"
	default "IEEE802154_nrf5"

config OT_PLAT_FLASH_PAGES_COUNT
	int
	prompt "Flash pages count used by OpenThread platform"
	default 4

endif
```

## tests/cmsis_rtos_v1/testcase.yaml
```yaml
tests:
  portability.cmsis_rtos_v1:
    tags: cmsis_rtos_v1
    filter: not CONFIG_HAS_COVERAGE_SUPPORT
    min_ram: 32
    min_flash: 34
  portability.cmsis_rtos_v1.cov:
    tags: cmsis_rtos_v1
    min_ram: 32
    min_flash: 34
    filter: CONFIG_HAS_COVERAGE_SUPPORT
    extra_args: CONF_FILE=prj_cov.conf
```

## tests/drivers/ipm/testcase.yaml
```yaml
tests:
  peripheral.mailbox:
    filter: not CONFIG_SOC_QUARK_SE_C1000_SS
    filter: not CONFIG_HAS_COVERAGE_SUPPORT
    arch_exclude: posix
    tags: drivers ipc
  peripheral.mailbox.gcov:
    filter: not CONFIG_SOC_QUARK_SE_C1000_SS
    arch_exclude: posix
    tags: drivers ipc
    filter: CONFIG_HAS_COVERAGE_SUPPORT
    extra_args: CONF_FILE=prj_cov.conf
```

## tests/kernel/mem_pool/mem_pool_api/testcase.yaml
```yaml
tests:
  kernel.memory_pool:
    filter: not CONFIG_HAS_COVERAGE_SUPPORT
    tags: kernel mem_pool
  kernel.memory_pool.coverage:
    filter: CONFIG_HAS_COVERAGE_SUPPORT
    extra_args: CONF_FILE=prj_cov.conf
    tags: kernel mem_pool
```

## tests/kernel/mem_protect/stackprot/testcase.yaml
```yaml
tests:
  kernel.memory_protection:
    arch_exclude: nios2 xtensa posix
    tags: bat_commit core ignore_faults
    filter: not CONFIG_HAS_COVERAGE_SUPPORT
  kernel.memory_protection.cov:
    arch_exclude: nios2 xtensa posix
    tags: bat_commit core ignore_faults
    filter: CONFIG_HAS_COVERAGE_SUPPORT
    extra_args: CONF_FILE=prj_cov.conf
```

## tests/kernel/profiling/profiling_api/testcase.yaml
```yaml
tests:
  kernel.profiling:
    arch_exclude: nios2 riscv32
    platform_exclude: em_starterkit
    filter: not CONFIG_HAS_COVERAGE_SUPPORT
    tags: kernel
  kernel.profiling.cov:
    arch_exclude: nios2 riscv32
    platform_exclude: em_starterkit
    filter: CONFIG_HAS_COVERAGE_SUPPORT
    extra_args: CONF_FILE=prj_cov.conf
    tags: kernel
```

## tests/lib/mem_alloc/testcase.yaml
```yaml
tests:
  libraries.libc.minimal:
    extra_args: CONF_FILE=prj.conf
    platform_exclude: native_posix
    tags: clib minimal_libc
  libraries.libc.newlib:
    extra_args: CONF_FILE=prj_newlib.conf
    platform_exclude: native_posix
    filter: not CONFIG_HAS_COVERAGE_SUPPORT
    tags: clib newlib
  libraries.libc.newlib.conv:
    extra_args: CONF_FILE=prj_newlib_cov.conf
    platform_exclude: native_posix
    filter: CONFIG_HAS_COVERAGE_SUPPORT
    tags: clib newlib
```

## tests/net/mgmt/testcase.yaml
```yaml
common:
  depends_on: netif
  platform_whitelist: native_posix qemu_x86 qemu_cortex_m3
tests:
  net.management:
    min_ram: 16
    filter: not CONFIG_HAS_COVERAGE_SUPPORT
    tags: net mgmt
  net.management.gcov:
    min_ram: 16
    filter: CONFIG_HAS_COVERAGE_SUPPORT
    extra_args: CONF_FILE=prj_cov.conf
    tags: net mgmt
```

## tests/net/mld/testcase.yaml
```yaml
common:
  platform_whitelist: native_posix qemu_x86 qemu_cortex_m3
tests:
  net.mld:
    tags: net mld
    filter: not CONFIG_HAS_COVERAGE_SUPPORT
    depends_on: netif
  net.mld.cov:
    tags: net mld
    filter: CONFIG_HAS_COVERAGE_SUPPORT
    extra_args: CONF_FILE=prj_cov.conf
    depends_on: netif
```

## tests/net/udp/testcase.yaml
```yaml
common:
  depends_on: netif
  platform_whitelist: native_posix qemu_x86 qemu_cortex_m3
tests:
  net.udp:
    min_ram: 20
    filter: not CONFIG_HAS_COVERAGE_SUPPORT
    tags: net
  net.udp.cov:
    min_ram: 20
    filter: CONFIG_HAS_COVERAGE_SUPPORT
    extra_args: CONF_FILE=prj_cov.conf
    tags: net
```
