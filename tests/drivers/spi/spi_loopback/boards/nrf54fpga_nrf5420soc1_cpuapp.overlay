/*
 * Copyright (c) 2021 Nordic Semiconductor ASA
 *
 * SPDX-License-Identifier: LicenseRef-Nordic-5-Clause
 */

&spi130 {
	status = "okay";
	sck-pin = <32>;
	miso-pin = <40>;
	mosi-pin = <41>;
	memory-regions = <&ram3x_cpuapp>;
};

&gpiote130 {
	status = "okay";
	owned-channels = <0 1>;
};

&gpio0 {
	status = "okay";
};
