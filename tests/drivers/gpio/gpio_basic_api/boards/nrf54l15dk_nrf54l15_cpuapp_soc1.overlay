/*
 * Copyright (c) 2023 Nordic Semiconductor ASA
 *
 * SPDX-License-Identifier: LicenseRef-Nordic-5-Clause
 */

 / {
	resources {
		compatible = "test-gpio-basic-api";
		out-gpios = <&gpio1 0 0>;
		in-gpios = <&gpio1 1 0>;
	};
};

&gpiote20 {
    status = "okay";
};

&gpio1 {
    status = "okay";
};
