## tests/drivers/clock_control/clock_control_api/testcase.yaml
```yaml
tests:
  drivers.clock.clock_control_nrf5:
    tags: drivers cloc
    platform_allow: nrf51dk_nrf51422 nrf52dk_nrf52832 nrf52840dk_nrf52840
                        nrf9160dk_nrf9160 nrf54l15dk_nrf54l15_cpuapp@soc1
    integration_platforms:
      - nrf51dk_nrf51422
  drivers.clock.clock_control_nrf5_lfclk_rc:
    tags: drivers clock
    platform_allow: nrf51dk_nrf51422 nrf52dk_nrf52832 nrf52840dk_nrf52840
                        nrf54l15dk_nrf54l15_cpuapp@soc1
    integration_platforms:
      - nrf51dk_nrf51422
    extra_args: CONF_FILE="nrf_lfclk_rc.conf"
```

## tests/drivers/clock_control/nrf_clock_calibration/testcase.yaml
```yaml
tests:
  drivers.clock.nrf5_clock_calibration:
    tags: drivers clock
    platform_allow: nrf51dk_nrf51422 nrf52dk_nrf52832 nrf52840dk_nrf52840
                        nrf54l15dk_nrf54l15_cpuapp@soc1
    integration_platforms:
      - nrf51dk_nrf51422
```

## tests/drivers/clock_control/onoff/testcase.yaml
```yaml
tests:
  drivers.clock.clock_control_onoff:
    tags: drivers clock
    platform_allow: nrf51dk_nrf51422 nrf52dk_nrf52832 nrf52840dk_nrf52840
                        nrf9160dk_nrf9160 nrf54l15dk_nrf54l15_cpuapp@soc1
    integration_platforms:
      - nrf51dk_nrf51422
```

## tests/drivers/counter/counter_basic_api/boards/nrf54l15dk_nrf54l15_cpuapp.conf
```kconfig
CONFIG_COUNTER_TIMER00=y
CONFIG_COUNTER_TIMER10=y
CONFIG_COUNTER_TIMER20=y
CONFIG_COUNTER_TIMER21=y
CONFIG_COUNTER_TIMER22=y
CONFIG_COUNTER_TIMER23=y
CONFIG_COUNTER_TIMER24=y
```

## tests/drivers/counter/counter_basic_api/testcase.yaml
```yaml
tests:
  drivers.counter.basic_api:
    tags: drivers counter
    depends_on: counter
    min_ram: 16
    platform_exclude: nucleo_f302r8
    timeout: 600
  drivers.counter.basic_api.nrf52_zli:
    tags: drivers counter
    depends_on: counter
    platform_allow: nrf52840dk_nrf52840
    timeout: 400
    extra_configs:
      - CONFIG_ZERO_LATENCY_IRQS=y
    extra_args:
      DTC_OVERLAY_FILE="boards/nrf52840dk_nrf52840.overlay;boards/nrf52840dk_nrf52840_zli.overlay"
  drivers.counter.basic_api.nrf54h_zli:
    tags: drivers counter
    depends_on: counter
    platform_allow: nrf54h20dk_nrf54h20_cpuapp@soc1
    timeout: 400
    extra_configs:
      - CONFIG_ZERO_LATENCY_IRQS=y
    extra_args:
      DTC_OVERLAY_FILE="boards/nrf54h20dk_nrf54h20_cpuapp_soc1.overlay;boards/nrf54h20dk_nrf54h20_zli.overlay"
```

## tests/drivers/counter/counter_nrf_rtc/fixed_top/testcase.yaml
```yaml
tests:
  drivers.counter.nrf_rtc:
    tags: drivers counter
    depends_on: counter
    platform_allow: nrf52840dk_nrf52840 nrf54h20dk_nrf54h20_cpusys@soc1 nrf54h20dk_nrf54h20_cpusec@soc1 nrf54h20dk_nrf54h20_cpuapp@soc1 nrf54h20dk_nrf54h20_cpurad@soc1 nrf54h20dk_nrf54h20_cpuppr@soc1 nrf54l15dk_nrf54l15_cpuapp@soc1
```

## tests/drivers/gpio/gpio_basic_api/testcase.yaml
```yaml
common:
  tags: drivers gpio
  depends_on: gpio
  harness: ztest
  harness_config:
    fixture: gpio_loopback

tests:
  drivers.gpio.2pin:
    min_flash: 34
    filter: dt_compat_enabled("test-gpio-basic-api")

  drivers.gpio.nrf_sense_edge_nrf52:
    platform_allow: nrf52840dk_nrf52840
    extra_args: "DTC_OVERLAY_FILE=boards/nrf52840dk_nrf52840_sense_edge.overlay"

  drivers.gpio.nrf_sense_edge_nrf54:
    platform_allow: nrf54h20dk_nrf54h20_cpuapp@soc1 nrf54h20dk_nrf54h20_cpuppr@soc1 nrf54l15dk_nrf54l15_cpuapp@soc1
```

## tests/drivers/i2c/i2c_tca954x/testcase.yaml
```yaml
tests:
  drivers.i2c.tca954x:
    build_only: true
    tags: testing drivers
    depends_on: i2c
    filter: dt_compat_enabled("ti,tca9546a")
    platform_allow: nrf52840dk_nrf52840 nrf54l15dk_nrf54l15_cpuapp@soc1
```

## tests/drivers/sensor/nrf5/testcase.yaml
```yaml
tests:
  drivers.sensor.nrf5.fpga:
    platform_allow: nrf54h20dk_nrf54h20_cpuapp@soc1, nrf54l15dk_nrf54l15_cpuapp@soc1
    tags: drivers
    extra_configs:
      - CONFIG_EMULATOR_FPGA=y
  drivers.sensor.nrf5.emu_z1:
    platform_allow: nrf54h20dk_nrf54h20_cpuapp@soc1, nrf54l15dk_nrf54l15_cpuapp@soc1
    tags: drivers
    extra_args: OVERLAY_CONFIGS="serial_emulator_z1.overlay"
    extra_configs:
      - CONFIG_EMULATOR_Z1=y
```

## tests/drivers/uart/uart_mix_fifo_poll/testcase.yaml
```yaml
common:
  tags: drivers uart
  depends_on: gpio
  harness: ztest
  platform_allow: nrf52840dk_nrf52840 nrf9160dk_nrf9160 nrf5340dk_nrf5340_cpuapp nrf54h20dk_nrf54h20_cpusys@soc1 nrf54h20dk_nrf54h20_cpusec@soc1 nrf54h20dk_nrf54h20_cpuapp@soc1 nrf54h20dk_nrf54h20_cpurad@soc1 nrf54h20dk_nrf54h20_cpuppr@soc1 nrf54l15dk_nrf54l15_cpuapp@soc1
  integration_platforms:
    - nrf52840dk_nrf52840
  harness_config:
    fixture: gpio_loopback
tests:
  drivers.uart.uart_mix_poll:
    extra_configs:
      - CONFIG_UART_INTERRUPT_DRIVEN=n
      - CONFIG_UART_ASYNC_API=n
      - CONFIG_UART_0_ENHANCED_POLL_OUT=n

  drivers.uart.uart_mix_poll_fifo:
    extra_configs:
      - CONFIG_UART_INTERRUPT_DRIVEN=y
      - CONFIG_UART_0_INTERRUPT_DRIVEN=y
      - CONFIG_UART_0_ENHANCED_POLL_OUT=n

  drivers.uart.uart_mix_poll_async_api:
    extra_configs:
      - CONFIG_UART_ASYNC_API=y
      - CONFIG_UART_0_INTERRUPT_DRIVEN=n
      - CONFIG_UART_0_ASYNC=y
      - CONFIG_UART_0_NRF_HW_ASYNC=y
      - CONFIG_UART_0_NRF_HW_ASYNC_TIMER=2
      - CONFIG_NRFX_TIMER2=y
      - CONFIG_UART_0_ENHANCED_POLL_OUT=n

  drivers.uart.uart_mix_poll_async_api_const:
    extra_args: TEST_CONST_BUFFER=1
    extra_configs:
      - CONFIG_UART_ASYNC_API=y
      - CONFIG_UART_0_INTERRUPT_DRIVEN=n
      - CONFIG_UART_0_ASYNC=y
      - CONFIG_UART_0_NRF_HW_ASYNC=y
      - CONFIG_UART_0_NRF_HW_ASYNC_TIMER=2
      - CONFIG_NRFX_TIMER2=y
      - CONFIG_UART_0_ENHANCED_POLL_OUT=n
      - CONFIG_UART_ASYNC_TX_CACHE_SIZE=2

  drivers.uart.uart_mix_poll_async_api_low_power:
    extra_configs:
      - CONFIG_UART_ASYNC_API=y
      - CONFIG_UART_0_INTERRUPT_DRIVEN=n
      - CONFIG_UART_0_ASYNC=y
      - CONFIG_UART_0_NRF_HW_ASYNC=y
      - CONFIG_UART_0_NRF_ASYNC_LOW_POWER=y
      - CONFIG_UART_0_NRF_HW_ASYNC_TIMER=2
      - CONFIG_NRFX_TIMER2=y
      - CONFIG_UART_0_ENHANCED_POLL_OUT=n

  drivers.uart.uart_mix_poll_with_ppi:
    extra_configs:
      - CONFIG_UART_INTERRUPT_DRIVEN=n
      - CONFIG_UART_ASYNC_API=n
      - CONFIG_UART_0_ENHANCED_POLL_OUT=y

  drivers.uart.uart_mix_poll_fifo_with_ppi:
    extra_configs:
      - CONFIG_UART_INTERRUPT_DRIVEN=y
      - CONFIG_UART_0_INTERRUPT_DRIVEN=y
      - CONFIG_UART_0_ENHANCED_POLL_OUT=y

  drivers.uart.uart_mix_poll_async_api_with_ppi:
    extra_configs:
      - CONFIG_UART_ASYNC_API=y
      - CONFIG_UART_0_INTERRUPT_DRIVEN=n
      - CONFIG_UART_0_ASYNC=y
      - CONFIG_UART_0_NRF_HW_ASYNC=y
      - CONFIG_UART_0_NRF_HW_ASYNC_TIMER=2
      - CONFIG_NRFX_TIMER2=y
      - CONFIG_UART_0_ENHANCED_POLL_OUT=y

  drivers.uart.uart_mix_poll_async_api_with_ppi_low_power:
    extra_configs:
      - CONFIG_UART_ASYNC_API=y
      - CONFIG_UART_0_INTERRUPT_DRIVEN=n
      - CONFIG_UART_0_ASYNC=y
      - CONFIG_UART_0_NRF_HW_ASYNC=y
      - CONFIG_UART_0_NRF_ASYNC_LOW_POWER=y
      - CONFIG_UART_0_NRF_HW_ASYNC_TIMER=2
      - CONFIG_NRFX_TIMER2=y
      - CONFIG_UART_0_ENHANCED_POLL_OUT=y
```

## tests/drivers/uart/uart_pm/testcase.yaml
```yaml
common:
  tags: drivers uart
  harness: ztest
  platform_allow: nrf52840dk_nrf52840  nrf54h20dk_nrf54h20_cpusys@soc1 nrf54h20dk_nrf54h20_cpusec@soc1 nrf54h20dk_nrf54h20_cpuapp@soc1 nrf54h20dk_nrf54h20_cpurad@soc1 nrf54h20dk_nrf54h20_cpuppr@soc1 nrf54l15dk_nrf54l15_cpuapp@soc1
  harness_config:
    fixture: gpio_loopback
  depends_on: gpio
tests:
  drivers.uart.pm:
    extra_configs:
      - CONFIG_UART_INTERRUPT_DRIVEN=n
      - CONFIG_UART_ASYNC_API=n
      - CONFIG_UART_0_ENHANCED_POLL_OUT=n

  drivers.uart.pm.no_rxpin:
    extra_configs:
      - CONFIG_UART_INTERRUPT_DRIVEN=n
      - CONFIG_UART_ASYNC_API=n
      - CONFIG_UART_0_ENHANCED_POLL_OUT=n
    platform_exclude: nrf54l15dk_nrf54l15_cpuapp@soc1
    extra_args: DTC_OVERLAY_FILE="boards/nrf52840dk_nrf52840.overlay;nrf_rx_disable.overlay"

  drivers.uart.pm.no_rxpin_54l:
    extra_configs:
      - CONFIG_UART_INTERRUPT_DRIVEN=n
      - CONFIG_UART_ASYNC_API=n
      - CONFIG_UART_0_ENHANCED_POLL_OUT=n
    platform_exclude: nrf52840dk_nrf52840  nrf54h20dk_nrf54h20_cpusys@soc1 nrf54h20dk_nrf54h20_cpusec@soc1 nrf54h20dk_nrf54h20_cpuapp@soc1 nrf54h20dk_nrf54h20_cpurad@soc1 nrf54h20dk_nrf54h20_cpuppr@soc1
    extra_args: DTC_OVERLAY_FILE="boards/nrf54l15dk_nrf54l15_cpuapp.overlay;nrf_rx_disable_54.overlay"

  drivers.uart.pm.enhanced_poll:
    extra_configs:
      - CONFIG_UART_INTERRUPT_DRIVEN=n
      - CONFIG_UART_ASYNC_API=n
      - CONFIG_UART_0_ENHANCED_POLL_OUT=y

  drivers.uart.pm.int_driven:
    extra_configs:
      - CONFIG_UART_INTERRUPT_DRIVEN=y
      - CONFIG_UART_0_INTERRUPT_DRIVEN=y
      - CONFIG_UART_ASYNC_API=n
      - CONFIG_UART_0_ENHANCED_POLL_OUT=n

  drivers.uart.pm.int_driven.enhanced_poll:
    extra_configs:
      - CONFIG_UART_INTERRUPT_DRIVEN=y
      - CONFIG_UART_0_INTERRUPT_DRIVEN=y
      - CONFIG_UART_ASYNC_API=n
      - CONFIG_UART_0_ENHANCED_POLL_OUT=y

  drivers.uart.pm.async:
    extra_configs:
      - CONFIG_UART_INTERRUPT_DRIVEN=n
      - CONFIG_UART_ASYNC_API=y
      - CONFIG_UART_0_ASYNC=y
      - CONFIG_UART_0_NRF_HW_ASYNC=y
      - CONFIG_UART_0_NRF_HW_ASYNC_TIMER=2
      - CONFIG_NRFX_TIMER2=y
      - CONFIG_UART_0_ENHANCED_POLL_OUT=n

  drivers.uart.pm.async.enhanced_poll:
    extra_configs:
      - CONFIG_UART_INTERRUPT_DRIVEN=n
      - CONFIG_UART_ASYNC_API=y
      - CONFIG_UART_0_ASYNC=y
      - CONFIG_UART_0_NRF_HW_ASYNC=y
      - CONFIG_UART_0_NRF_HW_ASYNC_TIMER=2
      - CONFIG_NRFX_TIMER2=y
      - CONFIG_UART_0_ENHANCED_POLL_OUT=y
```
