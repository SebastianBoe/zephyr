#include <common/nordic_nrf_next/nrfx_ram3x_dma.dtsi>

/ {
	chosen {
		zephyr,console = &uart136;
	};
};

&ram3x_cpuapp {
	status = "okay";
};

&uart136 {
	status = "okay";
	tx-pin = <0x44>;
	rx-pin = <0x45>;
	memory-regions = <&ram3x_cpuapp>;
};
