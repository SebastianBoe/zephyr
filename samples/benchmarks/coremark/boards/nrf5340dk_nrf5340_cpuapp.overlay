/*
 * Copyright (c) 2023 Nordic Semiconductor ASA
 *
 * SPDX-License-Identifier: Apache-2.0
 */

 #include "../app.overlay"

/ {
	gpio_fwd: nrf-gpio-forwarder {
		compatible = "nordic,nrf-gpio-forwarder";
		status = "okay";
		button_1 {
			gpios = < &gpio0 0x18 (GPIO_PULL_UP | GPIO_ACTIVE_LOW) >;
		};
		led_1 {
			gpios = < &gpio0 0x1d GPIO_ACTIVE_LOW >;
		};
	};
};
