/*
 * Copyright (c) 2019 Foundries.io
 *
 * SPDX-License-Identifier: Apache-2.0
 */

/*
 * WNC-M14A2A shield uses an odd UART available on *some* Arduino-R3-compatible
 * headers.  It needs to be defined individually.
 */
&uart2 {
	current-speed = <115200>;
	hw-flow-control;
	status = "ok";

	wncm14a2a {
		compatible = "wnc,m14a2a";
		label = "wncm14a2a";
		status = "ok";

		/* GPIOs are set by alias above */
	};
};
